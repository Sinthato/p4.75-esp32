/**************** PIN CONFIG ****************/
#define DATA_KIRI 23      
#define DATA_KANAN 19     
#define CLK 18
#define LAT 5
#define OE 4
#define A 15
#define B 2
#define C 16
#define DD 17

#define WIDTH 128
#define HEIGHT 16

uint8_t buffer[HEIGHT][WIDTH];

/**************** FONT DATA ****************/
// Kita simpan font ke dalam PROGMEM agar hemat RAM
const uint8_t font_alfabet[26][14] = {
  {0xC0,0x01,0x80,0x01,0xBF,0x9F,0xBF,0x9F,0x80,0x01,0xC0,0x01,0xFF,0xFF}, // A
  {0x80,0x01,0x80,0x01,0xBE,0x7D,0xBE,0x7D,0x80,0x01,0xC1,0x83,0xFF,0xFF}, // B
  {0xC0,0x03,0x80,0x01,0x9F,0xF9,0xBF,0xFD,0x9F,0xF9,0xCF,0xF3,0xFF,0xFF}, // C
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  {0xBF,0x81,0xBF,0x01,0xBE,0x7D,0xBC,0xFD,0x81,0xFD,0x81,0xFD,0xFF,0xFF}  // Z
};

const uint8_t font_angka[10][14] = {
  {0xC0,0x03,0x80,0x01,0xBF,0xFD,0xBF,0xFD,0x80,0x01,0xC0,0x03,0xFF,0xFF}, // 0
  {0xF7,0xF9,0xE7,0xF9,0x80,0x01,0x80,0x01,0xFF,0xF9,0xFF,0xF9,0xFF,0xFF}, // 1
  {0xC7,0x81,0x87,0x01,0xBE,0x39,0xBC,0x79,0x80,0xF9,0xC1,0xF9,0xFF,0xFF}, // 2
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  {0xC1,0xF3,0x80,0x71,0xBE,0x7D,0xBE,0x7D,0x80,0x01,0xC0,0x03,0xFF,0xFF}  // 9
};

/**************** LOGIKA TULISAN BERJALAN ****************/
String pesan = "GEMINI AI 2026"; 
int scrollX = WIDTH;

void clearBuffer() { memset(buffer, 0, sizeof(buffer)); }

void drawChar(char c, int x) {
  const uint8_t* f;
  if (c >= 'A' && c <= 'Z') f = font_alfabet[c - 'A'];
  else if (c >= '0' && c <= '9') f = font_angka[c - '0'];
  else return; // Spasi atau karakter lain kosong

  for (int col = 0; col < 7; col++) {
    int cx = x + col;
    if (cx >= 0 && cx < WIDTH) {
      uint8_t a = f[col * 2];
      uint8_t b = f[col * 2 + 1];
      for (int bit = 0; bit < 8; bit++) {
        buffer[bit][cx] = !(a & (1 << (7 - bit)));
        buffer[bit + 8][cx] = !(b & (1 << (7 - bit)));
      }
    }
  }
}

void drawString(String text, int x) {
  for (int i = 0; i < text.length(); i++) {
    drawChar(text[i], x + (i * 8)); // Jarak antar huruf 8 pixel
  }
}

/**************** SCANNING (Tetap Pakai Versi Stabilmu) ****************/
byte scanOrder[8] = {1, 3, 5, 7, 0, 2, 4, 6};

void scanLayer(bool bawah) {
  digitalWrite(DD, bawah);
  for (int i = 0; i < 8; i++) {
    int row = scanOrder[i];
    digitalWrite(OE, HIGH);
    digitalWrite(A, row & 1); digitalWrite(B, (row >> 1) & 1); digitalWrite(C, (row >> 2) & 1);

    for (int col = 0; col < WIDTH; col++) {
      digitalWrite(DATA_KIRI, buffer[row + (bawah ? 8 : 0)][col]);
      digitalWrite(DATA_KANAN, buffer[row + (bawah ? 8 : 0)][col]);
      digitalWrite(CLK, HIGH); digitalWrite(CLK, LOW);
    }
    digitalWrite(LAT, HIGH); delayMicroseconds(1); digitalWrite(LAT, LOW);
    digitalWrite(OE, LOW);
    delayMicroseconds(80); 
  }
}

void setup() {
  pinMode(DATA_KIRI, OUTPUT); pinMode(DATA_KANAN, OUTPUT);
  pinMode(CLK, OUTPUT); pinMode(LAT, OUTPUT); pinMode(OE, OUTPUT);
  pinMode(A, OUTPUT); pinMode(B, OUTPUT); pinMode(C, OUTPUT); pinMode(DD, OUTPUT);
  digitalWrite(OE, HIGH);
}

unsigned long lastMove = 0;
void loop() {
  if (millis() - lastMove > 40) { // Kecepatan jalan
    lastMove = millis();
    clearBuffer();
    drawString(pesan, scrollX);
    scrollX--;
    if (scrollX < (int)(pesan.length() * -8)) scrollX = WIDTH;
  }
  scanLayer(true);
  scanLayer(false);
}