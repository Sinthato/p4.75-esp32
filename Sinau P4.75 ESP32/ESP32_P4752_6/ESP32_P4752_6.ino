/**************** PIN CONFIGURATION (ESP32) ****************/
#define DATA_KIRI 23      
#define DATA_KANAN 19     
#define CLK 18
#define LAT 5
#define OE 4
#define A 15
#define B 2
#define C 16
#define DD 17

#define WIDTH 128
#define HEIGHT 16

uint8_t buffer[HEIGHT][WIDTH];

/**************** DATA PESAN ****************/
String pesanRunning = "SELAMAT DATANG DI MICROBAN ELECTRONICS#";
String pesanRollingUp = "SINAU ESP32#"; 
String pesanRollingDown = "SEMANGAT BELAJAR#"; 

/**************** FONT DATA  ****************/
//;                 Data Font Matrix 16x16
//;                 Dibuat oleh Sindhu Harimukti
//;                 sunday 03 feb 2013
/**************** FONT DATA ****************/
// (Pastikan data font_alfabet dan font_angka tetap ada di sini tanpa akhiran 'h')
const uint8_t font_alfabet[26][14] = {
  {0xC0,0x01,0x80,0x01,0xBF,0x9F,0xBF,0x9F,0x80,0x01,0xC0,0x01,0xFF,0xFF}, // A
  {0x80,0x01,0x80,0x01,0xBE,0x7D,0xBE,0x7D,0x80,0x01,0xC1,0x83,0xFF,0xFF}, // B
  {0xC0,0x03,0x80,0x01,0x9F,0xF9,0xBF,0xFD,0x9F,0xF9,0xCF,0xF3,0xFF,0xFF}, // C
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  {0xBF,0x81,0xBF,0x01,0xBE,0x7D,0xBC,0xFD,0x81,0xFD,0x81,0xFD,0xFF,0xFF}  // Z
};

const uint8_t font_angka[10][14] = {
  {0xC0,0x03,0x80,0x01,0xBF,0xFD,0xBF,0xFD,0x80,0x01,0xC0,0x03,0xFF,0xFF}, // 0
  {0xF7,0xF9,0xE7,0xF9,0x80,0x01,0x80,0x01,0xFF,0xF9,0xFF,0xF9,0xFF,0xFF}, // 1
  {0xC7,0x81,0x87,0x01,0xBE,0x39,0xBC,0x79,0x80,0xF9,0xC1,0xF9,0xFF,0xFF}, // 2
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  {0xC1,0xF3,0x80,0x71,0xBE,0x7D,0xBE,0x7D,0x80,0x01,0xC0,0x03,0xFF,0xFF}  // 9
};

/**************** VARIABLE KONTROL ****************/
int page = 1;         
int stateAnim = 0;    
int scrollX = WIDTH;
int scrollY = 0;
int wordIndex = 0;
String kataAktif = "";
unsigned long timerAnimasi = 0;
unsigned long timerTahan = 0;
unsigned long timerMenu4 = 0; 

/**************** FUNGSI LAYOUT BEBAS (MENU 4) ****************/
void layoutCustom() {
  // Di sini Anda bisa meletakkan banyak karakter sekaligus
  // Format: drawChar('Karakter', Kolom, Baris);
  
  drawChar('1', 0, 0);    // Angka 1 di kolom 0
  drawChar('2', 10, 0);   // Angka 2 di kolom 10
  drawChar('A', 30, 0);   // Huruf A di kolom 30
  
  // Anda juga bisa mencampur dengan string statis
  drawString("ESP", 60, 0); 
  
  drawChar('!', 120, 0);  // Tanda seru di ujung kanan
}

/**************** FUNGSI DASAR DRAWING ****************/
void clearBuffer() { memset(buffer, 0, sizeof(buffer)); }

void drawChar(char c, int x, int y) {
  const uint8_t* f = nullptr;
  if (c >= 'A' && c <= 'Z') f = font_alfabet[c - 'A'];
  else if (c >= '0' && c <= '9') f = font_angka[c - '0'];
  if (f == nullptr) return;

  for (int col = 0; col < 7; col++) {
    int cx = x + col;
    if (cx >= 0 && cx < WIDTH) {
      uint8_t a = f[col * 2];
      uint8_t b = f[col * 2 + 1];
      for (int bit = 0; bit < 8; bit++) {
        int cyA = y + bit;
        int cyB = y + bit + 8;
        if (cyA >= 0 && cyA < HEIGHT) buffer[cyA][cx] = !(a & (1 << (7 - bit)));
        if (cyB >= 0 && cyB < HEIGHT) buffer[cyB][cx] = !(b & (1 << (7 - bit)));
      }
    }
  }
}

void drawString(String t, int x, int y) {
  for (int i = 0; i < t.length(); i++) {
    if (t[i] == '#') break;
    drawChar(t[i], x + (i * 8), y);
  }
}

int getLengthNoHash(String t) {
  int l = 0;
  for (int i = 0; i < t.length(); i++) { if (t[i] == '#') break; l++; }
  return l;
}

String pecahKata(String sumber) {
  String hasil = "";
  while (wordIndex < sumber.length()) {
    char c = sumber[wordIndex];
    wordIndex++;
    if (c == ' ' || c == '#') {
      if (hasil.length() > 0) return hasil;
      if (c == '#') { wordIndex = 0; return "EOF"; }
      continue;
    }
    hasil += c;
  }
  wordIndex = 0; return "EOF";
}

/**************** HUB75 SCANNING ****************/
byte scanOrder[8] = {1, 3, 5, 7, 0, 2, 4, 6};
void scanLayer(bool bawah) {
  digitalWrite(DD, bawah);
  for (int i = 0; i < 8; i++) {
    int row = scanOrder[i];
    digitalWrite(OE, HIGH);
    digitalWrite(A, row & 1); digitalWrite(B, (row >> 1) & 1); digitalWrite(C, (row >> 2) & 1);
    for (int col = 0; col < WIDTH; col++) {
      digitalWrite(DATA_KIRI, buffer[row + (bawah ? 8 : 0)][col]);
      digitalWrite(DATA_KANAN, buffer[row + (bawah ? 8 : 0)][col]);
      digitalWrite(CLK, HIGH); 
      delayMicroseconds(1); // Tambahkan delay sangat kecil di sini
      digitalWrite(CLK, LOW);
    }
    digitalWrite(LAT, HIGH); delayMicroseconds(2); digitalWrite(LAT, LOW);
    digitalWrite(OE, LOW); delayMicroseconds(100); 
  }
}

/**************** MAIN SETUP & LOOP ****************/
void setup() {
  pinMode(DATA_KIRI, OUTPUT); pinMode(DATA_KANAN, OUTPUT);
  pinMode(CLK, OUTPUT); pinMode(LAT, OUTPUT); pinMode(OE, OUTPUT);
  pinMode(A, OUTPUT); pinMode(B, OUTPUT); pinMode(C, OUTPUT); pinMode(DD, OUTPUT);
  digitalWrite(OE, HIGH);
}

void loop() {
  if (millis() - timerAnimasi > 30) {
    timerAnimasi = millis();
    clearBuffer();

    if (page == 1) {
      // MENU 1: RUNNING TEXT HORIZONTAL
      drawString(pesanRunning, scrollX, 0);
      scrollX--;
      if (scrollX < (getLengthNoHash(pesanRunning) * -8)) {
        page = 2; wordIndex = 0;
        kataAktif = pecahKata(pesanRollingUp);
        scrollY = 16; stateAnim = 0;
      }
    } 
    else if (page == 2) {
      // MENU 2: ROLLING UP
      int centerX = (WIDTH / 2) - (kataAktif.length() * 4);
      if (stateAnim == 0) {
        drawString(kataAktif, centerX, scrollY);
        scrollY--; if (scrollY <= 0) { scrollY = 0; stateAnim = 1; timerTahan = millis(); }
      } 
      else if (stateAnim == 1) {
        drawString(kataAktif, centerX, 0);
        if (millis() - timerTahan > 1000) stateAnim = 2;
      } 
      else if (stateAnim == 2) {
        drawString(kataAktif, centerX, scrollY);
        scrollY--;
        if (scrollY < -16) {
          kataAktif = pecahKata(pesanRollingUp);
          if (kataAktif == "EOF") { 
            page = 3; wordIndex = 0; 
            kataAktif = pecahKata(pesanRollingDown); 
            scrollY = -16; stateAnim = 0; 
          } else { scrollY = 16; stateAnim = 0; }
        }
      }
    }
    else if (page == 3) {
      // MENU 3: ROLLING DOWN
      int centerX = (WIDTH / 2) - (kataAktif.length() * 4);
      if (stateAnim == 0) {
        drawString(kataAktif, centerX, scrollY);
        scrollY++; 
        if (scrollY >= 0) { scrollY = 0; stateAnim = 1; timerTahan = millis(); }
      }
      else if (stateAnim == 1) {
        drawString(kataAktif, centerX, 0);
        if (millis() - timerTahan > 1000) stateAnim = 2;
      }
      else if (stateAnim == 2) {
        drawString(kataAktif, centerX, scrollY);
        scrollY++; 
        if (scrollY > 16) {
          kataAktif = pecahKata(pesanRollingDown);
          if (kataAktif == "EOF") { 
            page = 4;           // Pindah ke Menu Layout Bebas
            timerMenu4 = millis(); 
          } else { scrollY = -16; stateAnim = 0; }
        }
      }
    }
    else if (page == 4) {
      // MENU 4: CUSTOM STATIC LAYOUT (BANYAK KARAKTER)
      layoutCustom(); 
      
      if (millis() - timerMenu4 > 5000) { // Tampil selama 5 detik
        page = 1; 
        scrollX = WIDTH;
      }
    }
  }

  scanLayer(true);
  scanLayer(false);
}